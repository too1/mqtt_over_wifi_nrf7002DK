## CMakeLists.txt
```
#
# Copyright (c) 2022 Nordic Semiconductor ASA
#
# SPDX-License-Identifier: LicenseRef-Nordic-5-Clause
#

cmake_minimum_required(VERSION 3.20.0)

find_package(Zephyr REQUIRED HINTS $ENV{ZEPHYR_BASE})
project(wifi_ble_provisioning)

target_sources(app PRIVATE src/main.c
                           src/app_mqtt.c
)

zephyr_library_include_directories(inc)
```

## Kconfig
```
#
# Copyright (c) 2022 Nordic Semiconductor ASA
#
# SPDX-License-Identifier: LicenseRef-Nordic-5-Clause
#
menu "MQTT over Wi-Fi"

module = WIFI_PROVISIONING
module-str = wifi provisioning service
source "${ZEPHYR_BASE}/subsys/logging/Kconfig.template.log_config"

config WIFI_PROV_ADV_DATA_UPDATE
	bool "Enable periodic update of advertisement data"
	default y

if WIFI_PROV_ADV_DATA_UPDATE

	config WIFI_PROV_ADV_DATA_UPDATE_INTERVAL
		int "Periodic update interval in second"
		default 5
endif # WIFI_PROV_ADV_DATA_UPDATE

config MQTT_PUB_TOPIC
	string "MQTT publish topic"
	default "devacademy/publish/topic44"

config MQTT_SUB_TOPIC
	string "MQTT subscribe topic"
	default "devacademy/subscribe/topic44"

config MQTT_PUB_TEMP_TOPIC
	string "MQTT temperature publish topic"
	default "devacademy/publish/topic44temp"

config MQTT_PUB_TEMP_ARRAY_TOPIC
	string "MQTT temperature graph publish topic"
	default "devacademy/publish/topic44temparray"

config TEMP_ARRAY_MAX_LENGTH
	int "Max number of items in the temperature array"
	default 16

config MQTT_SUB_TEMP_REQUEST_TOPIC
	string "MQTT temperature request subscribe topic"
	default "devacademy/subscribe/topic44tempreq"

config MQTT_CLIENT_ID
	string "MQTT Client ID"
	help
	  Use a custom Client ID string.
	default "nRF7002DK_Test_Ali"

config MQTT_BROKER_HOSTNAME
	string "MQTT broker hostname"
	default "test.mosquitto.org"

config MQTT_BROKER_PORT
	int "MQTT broker port"
	default 1883

config MQTT_MESSAGE_BUFFER_SIZE
	int "MQTT message buffer size"
	default 128

config MQTT_PAYLOAD_BUFFER_SIZE
	int "MQTT payload buffer size"
	default 128

config BUTTON1_EVENT_PUBLISH_MSG
	string "The message to publish on a button event"
	default "Button 1 Pressed"

config BUTTON2_EVENT_PUBLISH_MSG
	string "The message to publish on a button event"
	default "Button 2 Pressed"

config TURN_LED1_ON_CMD
	string "Command to turn on LED"
	default "LED1ON"

config TURN_LED1_OFF_CMD
	string "Command to turn off LED"
	default "LED1OFF"

config TURN_LED2_ON_CMD
	string "Command to turn on LED"
	default "LED2ON"

config TURN_LED2_OFF_CMD
	string "Command to turn off LED"
	default "LED2OFF"


config MQTT_RECONNECT_DELAY_S
	int "Seconds to delay before attempting to reconnect to the broker."
	default 60
endmenu

source "Kconfig.zephyr"
```

## prj.conf
```kconfig
#
# Copyright (c) 2022 Nordic Semiconductor ASA
#
# SPDX-License-Identifier: LicenseRef-Nordic-5-Clause
#
CONFIG_WIFI=y
CONFIG_WIFI_NRF700X=y

# WPA supplicant
CONFIG_WPA_SUPP=y

# System settings
CONFIG_NEWLIB_LIBC=y
CONFIG_NEWLIB_LIBC_NANO=n

# Networking
CONFIG_NETWORKING=y
CONFIG_NET_SOCKETS=y
CONFIG_POSIX_CLOCK=y
CONFIG_NET_SOCKETS_POSIX_NAMES=y
CONFIG_NET_LOG=y
CONFIG_NET_IPV6=n
CONFIG_NET_IPV4=y
CONFIG_NET_UDP=y
CONFIG_NET_TCP=y
CONFIG_NET_DHCPV4=y
CONFIG_DNS_RESOLVER=y

CONFIG_NET_STATISTICS=y

CONFIG_NET_PKT_RX_COUNT=8
CONFIG_NET_PKT_TX_COUNT=8
CONFIG_POSIX_MAX_FDS=9
# Below section is the primary contributor to SRAM and is currently
# tuned for performance, but this will be revisited in the future.
CONFIG_NET_BUF_RX_COUNT=16
CONFIG_NET_BUF_TX_COUNT=16
CONFIG_NET_BUF_DATA_SIZE=512
CONFIG_HEAP_MEM_POOL_SIZE=153600
CONFIG_NET_TC_TX_COUNT=0

CONFIG_NET_IF_UNICAST_IPV4_ADDR_COUNT=1
CONFIG_NET_MAX_CONTEXTS=5
CONFIG_NET_CONTEXT_SYNC_RECV=y

CONFIG_INIT_STACKS=y

CONFIG_NET_L2_ETHERNET=y

CONFIG_NET_CONFIG_SETTINGS=y

CONFIG_NET_CONFIG_MY_IPV4_ADDR="192.165.100.150"
CONFIG_NET_CONFIG_PEER_IPV4_ADDR="192.165.100.1"

CONFIG_NET_SOCKETS_POLL_MAX=4

# Memories
CONFIG_MAIN_STACK_SIZE=4096
CONFIG_SYSTEM_WORKQUEUE_STACK_SIZE=2048
CONFIG_NET_TX_STACK_SIZE=4096
CONFIG_NET_RX_STACK_SIZE=4096

# Debugging
CONFIG_STACK_SENTINEL=y
CONFIG_DEBUG_COREDUMP=y
CONFIG_DEBUG_COREDUMP_BACKEND_LOGGING=y
CONFIG_DEBUG_COREDUMP_MEMORY_DUMP_MIN=y

# Kernel options
CONFIG_ENTROPY_GENERATOR=y

# Logging
CONFIG_LOG=y

CONFIG_NET_L2_WIFI_MGMT=y

CONFIG_NET_MGMT_EVENT_STACK_SIZE=2048

CONFIG_FLASH=y
CONFIG_FLASH_PAGE_LAYOUT=y
CONFIG_FLASH_MAP=y

CONFIG_NVS=y

CONFIG_SETTINGS=y
CONFIG_SETTINGS_NVS=y

CONFIG_NANOPB=y

# Button and LED support
CONFIG_DK_LIBRARY=y

# MQTT
CONFIG_MQTT_LIB=y
CONFIG_MQTT_CLEAN_SESSION=y

# Application
CONFIG_MQTT_PUB_TOPIC="devacademy/publish/emeaworkshop/button"
CONFIG_MQTT_SUB_TOPIC="devacademy/subscribe/emeaworkshop/led"

# Temperature related topics
CONFIG_MQTT_PUB_TEMP_TOPIC="devacademy/publish/emeaworkshop/temp"
CONFIG_MQTT_PUB_TEMP_ARRAY_TOPIC="devacademy/publish/emeaworkshop/temparray"
CONFIG_MQTT_SUB_TEMP_REQUEST_TOPIC="devacademy/subscribe/emeaworkshop/tempreq"

#Note If you notice that the test.mosquitto.org is unresponsive,
#there are several other public MQTT brokers that you can use (Ex: broker.hivemq.com at port 1883)
CONFIG_MQTT_BROKER_HOSTNAME="test.mosquitto.org"

CONFIG_MQTT_CLIENT_ID="nRF7002DK_Test_Ali"
CONFIG_MQTT_BROKER_PORT=1883
CONFIG_MQTT_RECONNECT_DELAY_S=30

## Bluetooth configuration
CONFIG_BT=y
CONFIG_BT_OBSERVER=y
CONFIG_BT_DEBUG_LOG=y
CONFIG_BT_SCAN=y
```

## src/main.c
```c
/*
 * Copyright (c) 2023 Nordic Semiconductor ASA
 *
 * SPDX-License-Identifier: LicenseRef-Nordic-5-Clause
 */

#include <zephyr/kernel.h>
#include <stddef.h>
#include <string.h>
#include <errno.h>
#include <zephyr/sys/printk.h>

#include <zephyr/net/wifi.h>
#include <zephyr/net/wifi_mgmt.h>

#include <zephyr/net/socket.h>
#include <zephyr/net/mqtt.h>
#include <dk_buttons_and_leds.h>

#include <zephyr/bluetooth/bluetooth.h>
#include <zephyr/bluetooth/hci.h>
#include <bluetooth/scan.h>

#include "app_mqtt.h"

LOG_MODULE_REGISTER(MQTT_OVER_WIFI, LOG_LEVEL_INF);

K_SEM_DEFINE(wifi_connected_sem, 0, 1);

#define NETWORK_SSID "EmeaWorkshop"
#define NETWORK_PWD  "BillionBluetooth"

static struct net_mgmt_event_callback wifi_prov_cb;

static bool mqtt_connected = false;

// Function for enabling or disabling TWT mode
static void wifi_set_twt(bool enable)
{
	struct net_if *iface = net_if_get_default();
	struct wifi_twt_params params = { 0 };
	uint8_t flow_id = 1;

	params.negotiation_type = WIFI_TWT_INDIVIDUAL;
	params.setup_cmd = WIFI_TWT_SETUP_CMD_REQUEST;
	params.flow_id = flow_id;

	if (enable){
		params.operation = WIFI_TWT_SETUP;
		params.setup.twt_interval_ms = 15000;
		params.setup.responder = 0;
		params.setup.trigger = 1;
		params.setup.implicit = 1;
		params.setup.announce = 1;
		params.setup.twt_wake_interval_ms = 65;
	} else {
		params.operation = WIFI_TWT_TEARDOWN;
		params.teardown.teardown_all = 1;
		flow_id = (flow_id < WIFI_MAX_TWT_FLOWS) ? flow_id + 1 : 1;
	}
	
	if (net_mgmt(NET_REQUEST_WIFI_TWT, iface, &params, sizeof(params))) {
		LOG_ERR("Operation %s with negotiation type %s failed", wifi_twt_operation2str[params.operation], wifi_twt_negotiation_type2str[params.negotiation_type]);
	}
	LOG_INF("TWT operation %s with flow_id: %d requested", wifi_twt_operation2str[params.operation], params.flow_id);
}

static void handle_wifi_twt_event(struct net_mgmt_event_callback *cb)
{
	const struct wifi_twt_params *resp = (const struct wifi_twt_params *)cb->info;

	LOG_INF("TWT response: CMD %s for dialog: %d and flow: %d\n",
	      wifi_twt_setup_cmd2str[resp->setup_cmd], resp->dialog_token, resp->flow_id);

	// If accepted, then no need to print TWT params
	if (resp->setup_cmd != WIFI_TWT_SETUP_CMD_ACCEPT) {
		LOG_INF("TWT parameters: trigger: %s wake_interval_ms: %d, interval_ms: %d\n",
		      resp->setup.trigger ? "trigger" : "no_trigger",
		      resp->setup.twt_wake_interval_ms,
		      resp->setup.twt_interval_ms);
	}
}

static void button_handler(uint32_t button_state, uint32_t has_changed)
{
	switch (has_changed) {
	case DK_BTN1_MSK:
		if (button_state & DK_BTN1_MSK){	
			int err = app_mqtt_publish(CONFIG_BUTTON1_EVENT_PUBLISH_MSG, 
									sizeof(CONFIG_BUTTON1_EVENT_PUBLISH_MSG)-1);
			if (err) {
				LOG_ERR("Failed to send message, %d", err);
				return;	
			}
		}
		break;
	case DK_BTN2_MSK:
		if (button_state & DK_BTN2_MSK){	
			wifi_set_twt(true);
		}
		break;
	}
}

static float read_temperature(void)
{
	// Keep track of the previously returned temperature
	static float previous_temp = 20.0f;

	// Generate a random temperature in the range 0-40 C
	float random_temp = (float)(rand() % 40001) * 0.001f;

	// Set the temperature to a mix of the old and the new, in order to simulate a slowly changing temperature
	previous_temp = previous_temp * 0.9f + random_temp * 0.1f;
	
	return previous_temp;
}

static void mqtt_connected_handler(void)
{
	dk_set_led_on(DK_LED2);
	mqtt_connected = true;
}

static void mqtt_disconnected_handler(int result)
{
	dk_set_led_off(DK_LED2);
	mqtt_connected = false;
}

static void mqtt_data_rx_handler(const uint8_t *data, uint32_t len, const uint8_t *topic_string)
{
	// Verify the topic of the incoming message
	if (strcmp(topic_string, CONFIG_MQTT_SUB_TOPIC) == 0) {
		// Control LED1 and LED2 
		if (strncmp(data, CONFIG_TURN_LED1_ON_CMD, sizeof(CONFIG_TURN_LED1_ON_CMD) - 1) == 0) {
			dk_set_led_on(DK_LED1);
		}
		else if (strncmp(data, CONFIG_TURN_LED1_OFF_CMD, sizeof(CONFIG_TURN_LED1_OFF_CMD) - 1) == 0) {
			dk_set_led_off(DK_LED1);
		}
		else if (strncmp(data, CONFIG_TURN_LED2_ON_CMD, sizeof(CONFIG_TURN_LED2_ON_CMD) - 1) == 0) {
			//dk_set_led_on(DK_LED2);
		}
		else if (strncmp(data, CONFIG_TURN_LED2_OFF_CMD, sizeof(CONFIG_TURN_LED2_OFF_CMD) - 1) == 0) {
			//dk_set_led_off(DK_LED2);
		}
	}
	// Check if something is received on the temperature request topic
	else if (strcmp(topic_string, CONFIG_MQTT_SUB_TEMP_REQUEST_TOPIC) == 0) {
		// If anything is received on the temp request topic, send a temperature reading in return
		app_mqtt_publish_temp(read_temperature());
	}
}

const struct app_mqtt_callbacks_t mqtt_callbacks = {
	.connected = mqtt_connected_handler,
	.disconnected = mqtt_disconnected_handler,
	.data_rx = mqtt_data_rx_handler
};

static void wifi_connect_handler(struct net_mgmt_event_callback *cb,
				    uint32_t mgmt_event, struct net_if *iface)
{
	switch (mgmt_event) {
		case NET_EVENT_WIFI_CONNECT_RESULT:
			LOG_INF("Connected to a Wi-Fi Network");
			k_sem_give(&wifi_connected_sem);
			break;
		case NET_EVENT_WIFI_TWT:
			handle_wifi_twt_event(cb);
			break;
		default:
			break;
	}
}

K_SEM_DEFINE(sem_temp_from_beacon, 0, 1);
static float temp_from_beacon;

static void temp_update_thread_func(void *p)
{
	float current_temperature;
	static float temperature_list[CONFIG_TEMP_ARRAY_MAX_LENGTH];
	int temperature_list_count = 0;

	while (1) {
		if(mqtt_connected) {
			if (k_sem_take(&sem_temp_from_beacon, K_NO_WAIT) == 0)  {
				LOG_INF("Reading temperature from beacon data");
				current_temperature = temp_from_beacon;
			} else {
				LOG_INF("No beacon found. Using simulated temperature data");
				current_temperature = read_temperature();
			}

			// Send the current temperature over MQTT
			app_mqtt_publish_temp(current_temperature);
			
			// Update and send a list of the current temperature, as well as previous readings
			if(temperature_list_count < CONFIG_TEMP_ARRAY_MAX_LENGTH) {
				temperature_list[temperature_list_count++] = current_temperature;
			} else {
				// In case the list is full, move all existing values one step up to make room for another value
				for(int i = 0; i < (CONFIG_TEMP_ARRAY_MAX_LENGTH - 1); i++) {
					temperature_list[i] = temperature_list[i + 1];
				}
				temperature_list[CONFIG_TEMP_ARRAY_MAX_LENGTH - 1] = current_temperature;
			}
			app_mqtt_publish_temp_array(temperature_list, temperature_list_count);
		}
		k_msleep(10000);
	}
}

uint8_t *beacon_short_name = "TempBeacon";
struct adv_mfg_data {
	uint16_t company_code;
	uint16_t temperature; 
	uint32_t rnd_number;  
} __packed;

static struct adv_mfg_data beacon_data;
static bool valid_name_found, valid_manuf_data_found; 

static bool data_cb(struct bt_data *data, void *user_data)
{
	switch (data->type) {
		case BT_DATA_NAME_COMPLETE:
			if(memcmp(data->data, beacon_short_name, strlen(beacon_short_name)) == 0) {
				valid_name_found = true;
			}
			return true;
		case BT_DATA_MANUFACTURER_DATA:
			if(data->data_len == sizeof(struct adv_mfg_data)) {
				memcpy(&beacon_data, data->data, data->data_len);
				if(beacon_data.company_code == 0x0059) {
					LOG_DBG("NORDIC beacon found! Temp %x, Rnd %x", 
							beacon_data.temperature, beacon_data.rnd_number);
					valid_manuf_data_found = true;
					return false;
				}
			}
			return true;
		default:
			return true;
	}
}

void on_scan_no_match(struct bt_scan_device_info *device_info, bool connectable)
{
	valid_name_found = valid_manuf_data_found = false;
	bt_data_parse(device_info->adv_data, data_cb, (void *)&device_info->recv_info->addr);
	if(valid_name_found && valid_manuf_data_found) {
		temp_from_beacon = (float)beacon_data.temperature * 0.25f;
		k_sem_give(&sem_temp_from_beacon);
	}
}

BT_SCAN_CB_INIT(scan_cb, NULL, on_scan_no_match, NULL, NULL);

static int bt_init(void)
{
	int err;

	struct bt_le_scan_param my_scan_params = {
		.type       = BT_LE_SCAN_TYPE_ACTIVE,
		.options    = BT_LE_SCAN_OPT_NONE,
		.interval   = (BT_GAP_SCAN_FAST_INTERVAL * 4),
		.window     = BT_GAP_SCAN_FAST_WINDOW,
	};

	struct bt_scan_init_param scan_init = {
		.scan_param = &my_scan_params,
	};

	err = bt_enable(0);
	if (err) {
		LOG_ERR("BT enable failed (err %i)", err);
		return err;
	}

	bt_scan_init(&scan_init);
	bt_scan_cb_register(&scan_cb);

	err = bt_scan_start(BT_SCAN_TYPE_SCAN_PASSIVE);
	if (err) {
		LOG_ERR("Scanning failed to start (err %d)", err);
		return err;
	}

	LOG_INF("Bluetooth initialized");
	return 0;
}

void main(void)
{
	int rc;
	struct net_if *iface = net_if_get_default();
	struct wifi_connect_req_params cnx_params = { 0 };

	// Sleep 1 seconds to allow initialization of wifi driver.
	k_sleep(K_SECONDS(1));

	if (dk_leds_init() != 0) {
		LOG_ERR("Failed to initialize the LED library");
	}

	if (dk_buttons_init(button_handler) != 0) {
		LOG_ERR("Failed to initialize the buttons library");
	}

	bt_init();

	LOG_INF("Using static Wi-Fi configuration\n");
	char *wifi_static_ssid = NETWORK_SSID;
	char *wifi_static_pwd = NETWORK_PWD;

	cnx_params.ssid = wifi_static_ssid;
	cnx_params.ssid_length = strlen(wifi_static_ssid);
	cnx_params.security = WIFI_SECURITY_TYPE_PSK;

	cnx_params.psk = NULL;
	cnx_params.psk_length = 0;
	cnx_params.sae_password = NULL;
	cnx_params.sae_password_length = 0;

	cnx_params.psk = wifi_static_pwd;
	cnx_params.psk_length = strlen(wifi_static_pwd);

	cnx_params.channel = WIFI_CHANNEL_ANY;
	cnx_params.band = WIFI_FREQ_BAND_2_4_GHZ;
	cnx_params.mfp = WIFI_MFP_OPTIONAL;
	rc = net_mgmt(NET_REQUEST_WIFI_CONNECT, iface,
		&cnx_params, sizeof(struct wifi_connect_req_params));
	if (rc < 0) {
		LOG_ERR("Cannot apply saved Wi-Fi configuration, err = %d.\n", rc);
	} else {
		LOG_INF("Configuration applied.\n");
	}

	net_mgmt_init_event_callback(&wifi_prov_cb, wifi_connect_handler, NET_EVENT_WIFI_CONNECT_RESULT | NET_EVENT_WIFI_TWT);

	net_mgmt_add_event_callback(&wifi_prov_cb);

	k_sem_take(&wifi_connected_sem, K_FOREVER);

	// Wait for the interface to be up
	k_sleep(K_SECONDS(6));

	LOG_INF("Connecting to MQTT Broker...");

	// Sett the callbacks for the app_mqtt module
	app_mqtt_set_callbacks(&mqtt_callbacks);

	// Run the MQTT connect loop (NOTE: this function will never exit)
	app_mqtt_run();
}

// Define an additional thread that will be used to send regular temperature updates
K_THREAD_DEFINE(temp_update_thread, 2048, temp_update_thread_func, 
				0, 0, 0, // P1, P2, P3
				K_LOWEST_APPLICATION_THREAD_PRIO, 0, 0); // Priority, Options, Delay
```

## src/app_mqtt.c
```c
/*
 * Copyright (c) 2023 Nordic Semiconductor ASA
 *
 * SPDX-License-Identifier: LicenseRef-Nordic-5-Clause
 */
#include "app_mqtt.h"
#include <stdio.h>
#include <string.h>
#include <zephyr/random/rand32.h>
#include <zephyr/net/socket.h>
#include <zephyr/net/mqtt.h>
#include <zephyr/sys/util.h>

#include <zephyr/logging/log.h>
LOG_MODULE_REGISTER(APP_MQTT, LOG_LEVEL_DBG);

/* Buffers for MQTT client. */
static uint8_t rx_buffer[CONFIG_MQTT_MESSAGE_BUFFER_SIZE];
static uint8_t tx_buffer[CONFIG_MQTT_MESSAGE_BUFFER_SIZE];
static uint8_t payload_buf[CONFIG_MQTT_PAYLOAD_BUFFER_SIZE];
static uint8_t topic_buf[CONFIG_MQTT_PAYLOAD_BUFFER_SIZE];

/* MQTT Broker details. */
static struct sockaddr_storage broker;

/* The mqtt client struct */
static struct mqtt_client client;

/* File descriptor */
static struct pollfd fds;

/* Function pointers allowing the app_mqtt module to forward various events to the application */
static struct app_mqtt_callbacks_t registered_callbacks = {0};

/**@brief Function to get the payload of recived data.
 */
static int get_received_payload(struct mqtt_client *c, size_t length)
{
	int ret;
	int err = 0;

	/* Return an error if the payload is larger than the payload buffer.
	 * Note: To allow new messages, we have to read the payload before returning.
	 */
	if (length > sizeof(payload_buf)) {
		err = -EMSGSIZE;
	}

	/* Truncate payload until it fits in the payload buffer. */
	while (length > sizeof(payload_buf)) {
		ret = mqtt_read_publish_payload_blocking(
				c, payload_buf, (length - sizeof(payload_buf)));
		if (ret == 0) {
			return -EIO;
		} else if (ret < 0) {
			return ret;
		}

		length -= ret;
	}

	ret = mqtt_readall_publish_payload(c, payload_buf, length);
	if (ret) {
		return ret;
	}

	return err;
}

/**@brief Function to subscribe to the configured topic
 */
static int subscribe(struct mqtt_client *const c)
{
	struct mqtt_topic subscribe_topics[] = {
		{
			.topic = {
				.utf8 = CONFIG_MQTT_SUB_TOPIC,
				.size = strlen(CONFIG_MQTT_SUB_TOPIC)
			},
			.qos = MQTT_QOS_1_AT_LEAST_ONCE
		},
		{
			.topic = {
				.utf8 = CONFIG_MQTT_SUB_TEMP_REQUEST_TOPIC,
				.size = strlen(CONFIG_MQTT_SUB_TEMP_REQUEST_TOPIC)
			},
			.qos = MQTT_QOS_1_AT_LEAST_ONCE
		},
	};

	const struct mqtt_subscription_list subscription_list = {
		.list = subscribe_topics,
		.list_count = ARRAY_SIZE(subscribe_topics),
		.message_id = 1234
	};

	for(int i = 0; i < ARRAY_SIZE(subscribe_topics); i++) {
		LOG_DBG("Subscribing to: %s len %u", subscribe_topics[i].topic.utf8, subscribe_topics[i].topic.size);
	}

	return mqtt_subscribe(c, &subscription_list);
}

/**@brief Function to print strings without null-termination
 */
static void data_print(uint8_t *prefix, uint8_t *data, size_t len)
{
	char buf[len + 1];

	memcpy(buf, data, len);
	buf[len] = 0;
	LOG_DBG("%s%s", (char *)prefix, (char *)buf);
}

/**@brief Generic function to publish data on any topic
 */
int data_publish_generic(struct mqtt_client *c, char *topic, uint8_t *data, size_t len)
{
	struct mqtt_publish_param param;

	param.message.topic.qos = MQTT_QOS_1_AT_LEAST_ONCE;
	param.message.topic.topic.utf8 = topic;
	param.message.topic.topic.size = strlen(topic);
	param.message.payload.data = data;
	param.message.payload.len = len;
	param.message_id = sys_rand32_get();
	param.dup_flag = 0;
	param.retain_flag = 0;

	data_print("Publishing: ", data, len);
	LOG_DBG("to topic: %s len: %u", topic, (unsigned int)strlen(topic));

	return mqtt_publish(c, &param);
}

/**@brief Function to publish data on the default topic
 */
int app_mqtt_publish(uint8_t *data, size_t len)
{
	return data_publish_generic(&client, CONFIG_MQTT_PUB_TOPIC, data, len);
}

/**@brief Function to publish data on the temperature topic
 */
int app_mqtt_publish_temp(float temp)
{
	static uint8_t temp_string[16];
	sprintf(temp_string, "%.1f C", temp);
	return data_publish_generic(&client, CONFIG_MQTT_PUB_TEMP_TOPIC, temp_string, strlen(temp_string));
}

/**@brief Function to publish data on the temperature graph topic
 */
int app_mqtt_publish_temp_array(float *temp_list, int len)
{
	// Ensure that the provided length doesn't exceed the maximum allowed
	len = MIN(len, CONFIG_TEMP_ARRAY_MAX_LENGTH);
	// Create a temporary array for the string. 
	uint8_t temp_array_string[len * 5 + 3];
	// Use sprintf to assemble the string, starting with the header bracket
	sprintf(temp_array_string, "[");
	for(int i = 0; i < len; i++) {
		sprintf(temp_array_string, "%s%.1f,", temp_array_string, temp_list[i]);
	}
	// Remove the last comma by setting the last value of the string to 0
	temp_array_string[strlen(temp_array_string) - 1] = 0;
	// Add the end bracket
	sprintf(temp_array_string, "%s]", temp_array_string);
	// Send the array string over MQTT
	return data_publish_generic(&client, CONFIG_MQTT_PUB_TEMP_ARRAY_TOPIC, temp_array_string, strlen(temp_array_string));
}

/**@brief MQTT client event handler
 */
void mqtt_evt_handler(struct mqtt_client *const c,
		      const struct mqtt_evt *evt)
{
	int err;

	switch (evt->type) {
	case MQTT_EVT_CONNACK:
		if (evt->result != 0) {
			LOG_ERR("MQTT connect failed: %d", evt->result);
			break;
		}

		// Call the connected callback, unless it is not set (NULL)
		if(registered_callbacks.connected) {
			registered_callbacks.connected();
		}
		
		subscribe(c);
		break;

	case MQTT_EVT_DISCONNECT:
		LOG_DBG("MQTT client disconnected: %d", evt->result);

		// Call the disconnected callback, unless it is not set (NULL) 
		if(registered_callbacks.disconnected) {
			registered_callbacks.disconnected(evt->result);
		}
		break;

	case MQTT_EVT_PUBLISH:
	{
		const struct mqtt_publish_param *p = &evt->param.publish;
		// Print the length of the recived message 
		LOG_DBG("MQTT PUBLISH result=%d len=%d",
			evt->result, p->message.payload.len);

		// Extract the data of the recived message 
		err = get_received_payload(c, p->message.payload.len);
		
		// Send acknowledgment to the broker on receiving QoS1 publish message 
		if (p->message.topic.qos == MQTT_QOS_1_AT_LEAST_ONCE) {
			const struct mqtt_puback_param ack = {
				.message_id = p->message_id
			};

			// Send acknowledgment
			mqtt_publish_qos1_ack(c, &ack);
		}

		if (err >= 0) {
			data_print("Received: ", payload_buf, p->message.payload.len);

			// Store the topic name in a separate null terminated string
			int topic_len = MIN(CONFIG_MQTT_PAYLOAD_BUFFER_SIZE - 1, p->message.topic.topic.size);
			memcpy(topic_buf, p->message.topic.topic.utf8, topic_len);
			topic_buf[topic_len] = 0;

			// Call the data_rx callback as long as it is set, and provide the payload data
			if(registered_callbacks.data_rx) {

				registered_callbacks.data_rx(payload_buf, p->message.payload.len, topic_buf);
			}
		} 
		// Payload buffer is smaller than the received data 
		else if (err == -EMSGSIZE) {
			LOG_ERR("Received payload (%d bytes) is larger than the payload buffer size (%d bytes).",
				p->message.payload.len, sizeof(payload_buf));
		} 
		// Failed to extract data, disconnect 
		else {
			LOG_ERR("get_received_payload failed: %d", err);
			LOG_INF("Disconnecting MQTT client...");

			err = mqtt_disconnect(c);
			if (err) {
				LOG_ERR("Could not disconnect: %d", err);
			}
		}
	} break;

	case MQTT_EVT_PUBACK:
		if (evt->result != 0) {
			LOG_ERR("MQTT PUBACK error: %d", evt->result);
			break;
		}

		LOG_DBG("PUBACK packet id: %u", evt->param.puback.message_id);
		break;

	case MQTT_EVT_SUBACK:
		if (evt->result != 0) {
			LOG_ERR("MQTT SUBACK error: %d", evt->result);
			break;
		}

		LOG_DBG("SUBACK packet id: %u", evt->param.suback.message_id);
		break;

	case MQTT_EVT_PINGRESP:
		if (evt->result != 0) {
			LOG_ERR("MQTT PINGRESP error: %d", evt->result);
		}
		break;

	default:
		LOG_WRN("Unhandled MQTT event type: %d", evt->type);
		break;
	}
}

/**@brief Resolves the configured hostname and
 * initializes the MQTT broker structure
 */
static int broker_init(void)
{
	int err;
	struct addrinfo *result;
	struct addrinfo *addr;
	struct addrinfo hints = {
		.ai_family = AF_INET,
		.ai_socktype = SOCK_STREAM
	};

	err = getaddrinfo(CONFIG_MQTT_BROKER_HOSTNAME, NULL, &hints, &result);
	if (err) {
		LOG_ERR("getaddrinfo failed: %d", err);
		return -ECHILD;
	}

	addr = result;

	/* Look for address of the broker. */
	while (addr != NULL) {
		/* IPv4 Address. */
		if (addr->ai_addrlen == sizeof(struct sockaddr_in)) {
			struct sockaddr_in *broker4 =
				((struct sockaddr_in *)&broker);
			char ipv4_addr[NET_IPV4_ADDR_LEN];

			broker4->sin_addr.s_addr =
				((struct sockaddr_in *)addr->ai_addr)
				->sin_addr.s_addr;
			broker4->sin_family = AF_INET;
			broker4->sin_port = htons(CONFIG_MQTT_BROKER_PORT);

			inet_ntop(AF_INET, &broker4->sin_addr.s_addr,
				  ipv4_addr, sizeof(ipv4_addr));
			LOG_INF("IPv4 Address found %s", (char *)(ipv4_addr));

			break;
		} else {
			LOG_ERR("ai_addrlen = %u should be %u or %u",
				(unsigned int)addr->ai_addrlen,
				(unsigned int)sizeof(struct sockaddr_in),
				(unsigned int)sizeof(struct sockaddr_in6));
		}

		addr = addr->ai_next;
	}

	/* Free the address. */
	freeaddrinfo(result);

	return err;
}

/* Function to get the client id */
static const uint8_t* client_id_get(void)
{
	static uint8_t client_id[MAX(sizeof(CONFIG_MQTT_CLIENT_ID),
				     CLIENT_ID_LEN)];

	if (strlen(CONFIG_MQTT_CLIENT_ID) > 0) {
		snprintf(client_id, sizeof(client_id), "%s",
			 CONFIG_MQTT_CLIENT_ID);
		goto exit;
	}

	uint32_t id = sys_rand32_get();
	snprintf(client_id, sizeof(client_id), "%s-%010u", CONFIG_BOARD, id);

exit:
	LOG_DBG("client_id = %s", (char *)client_id);

	return client_id;
}

/**@brief Initialize the MQTT client structure
 */
int client_init(struct mqtt_client *client)
{
	int err;
	/* Initializes the client instance. */
	mqtt_client_init(client);

	/* Resolves the configured hostname and initializes the MQTT broker structure */
	err = broker_init();
	if (err) {
		LOG_ERR("Failed to initialize broker connection");
		return err;
	}

	/* MQTT client configuration */
	client->broker = &broker;
	client->evt_cb = mqtt_evt_handler;
	client->client_id.utf8 = client_id_get();
	client->client_id.size = strlen(client->client_id.utf8);
	client->password = NULL;
	client->user_name = NULL;
	client->protocol_version = MQTT_VERSION_3_1_1;

	/* MQTT buffers configuration */
	client->rx_buf = rx_buffer;
	client->rx_buf_size = sizeof(rx_buffer);
	client->tx_buf = tx_buffer;
	client->tx_buf_size = sizeof(tx_buffer);

	/* We are not using TLS */
	client->transport.type = MQTT_TRANSPORT_NON_SECURE;

	return err;
}

/**@brief Initialize the file descriptor structure used by poll.
 */
int fds_init(struct mqtt_client *c, struct pollfd *fds)
{
	if (c->transport.type == MQTT_TRANSPORT_NON_SECURE) {
		fds->fd = c->transport.tcp.sock;
	} else {
		return -ENOTSUP;
	}

	fds->events = POLLIN;
	return 0;
}

void app_mqtt_set_callbacks(const struct app_mqtt_callbacks_t *callbacks)
{
	registered_callbacks = *callbacks;
}

void app_mqtt_run(void)
{
	int err;
	uint32_t connect_attempt = 0;

	err = client_init(&client);
	if (err) {
		LOG_ERR("Failed to initialize MQTT client: %d", err);
		return;
	}

	while (1) {
		do {
			if (connect_attempt++ > 0) {
				LOG_INF("Reconnecting in %d seconds...", CONFIG_MQTT_RECONNECT_DELAY_S);
				k_sleep(K_SECONDS(CONFIG_MQTT_RECONNECT_DELAY_S));
			}
			err = mqtt_connect(&client);
			if (err) {
				LOG_ERR("Error in mqtt_connect: %d", err);
			}
		} while (err != 0);

		err = fds_init(&client,&fds);
		if (err) {
			LOG_ERR("Error in fds_init: %d", err);
			return;
		}

		while (1) {
			err = poll(&fds, 1, mqtt_keepalive_time_left(&client));
			if (err < 0) {
				LOG_ERR("Error in poll(): %d", errno);
				break;
			}

			err = mqtt_live(&client);
			if ((err != 0) && (err != -EAGAIN)) {
				LOG_ERR("Error in mqtt_live: %d", err);
				break;
			}

			if ((fds.revents & POLLIN) == POLLIN) {
				err = mqtt_input(&client);
				if (err != 0) {
					LOG_ERR("Error in mqtt_input: %d", err);
					break;
				}
			}

			if ((fds.revents & POLLERR) == POLLERR) {
				LOG_ERR("POLLERR");
				break;
			}

			if ((fds.revents & POLLNVAL) == POLLNVAL) {
				LOG_ERR("POLLNVAL");
				break;
			}
		}

		LOG_INF("Disconnecting MQTT client");

		err = mqtt_disconnect(&client);
		if (err) {
			LOG_ERR("Could not disconnect MQTT client: %d", err);
		}
	}
}
```

## src/app_mqtt.h
```c
/*
 * Copyright (c) 2023 Nordic Semiconductor ASA
 *
 * SPDX-License-Identifier: LicenseRef-Nordic-5-Clause
 */
#ifndef __APP_MQTT_H
#define __APP_MQTT_H

#include <zephyr/kernel.h>

#define RANDOM_LEN 10
#define CLIENT_ID_LEN sizeof(CONFIG_BOARD) + 1 + RANDOM_LEN

typedef void (*app_mqtt_connected_cb)(void);
typedef void (*app_mqtt_disconnected_cb)(int result);
typedef void (*app_mqtt_data_rx_cb)(const uint8_t *data, uint32_t len, const uint8_t *topic_string);

struct app_mqtt_callbacks_t {
	app_mqtt_connected_cb connected;
	app_mqtt_disconnected_cb disconnected;
	app_mqtt_data_rx_cb data_rx;
};

void app_mqtt_set_callbacks(const struct app_mqtt_callbacks_t *callbacks);

int app_mqtt_publish(uint8_t *data, size_t len);

int app_mqtt_publish_temp(float temp);

int app_mqtt_publish_temp_array(float *temp_list, int len);

void app_mqtt_run(void);

#endif 
```

## src/mqtt_connection.c
```c
/*
 * Copyright (c) 2023 Nordic Semiconductor ASA
 *
 * SPDX-License-Identifier: LicenseRef-Nordic-5-Clause
 */
#include <stdio.h>
#include <string.h>
#include <zephyr/kernel.h>
#include <zephyr/random/rand32.h>
#include <zephyr/net/socket.h>
#include <zephyr/net/mqtt.h>
#include <zephyr/logging/log.h>
#include <dk_buttons_and_leds.h>
#include "mqtt_connection.h"

/* Buffers for MQTT client. */
static uint8_t rx_buffer[CONFIG_MQTT_MESSAGE_BUFFER_SIZE];
static uint8_t tx_buffer[CONFIG_MQTT_MESSAGE_BUFFER_SIZE];
static uint8_t payload_buf[CONFIG_MQTT_PAYLOAD_BUFFER_SIZE];

/* MQTT Broker details. */
static struct sockaddr_storage broker;

LOG_MODULE_DECLARE(MQTT_OVER_WIFI);

/**@brief Function to get the payload of recived data.
 */
static int get_received_payload(struct mqtt_client *c, size_t length)
{
	int ret;
	int err = 0;

	/* Return an error if the payload is larger than the payload buffer.
	 * Note: To allow new messages, we have to read the payload before returning.
	 */
	if (length > sizeof(payload_buf)) {
		err = -EMSGSIZE;
	}

	/* Truncate payload until it fits in the payload buffer. */
	while (length > sizeof(payload_buf)) {
		ret = mqtt_read_publish_payload_blocking(
				c, payload_buf, (length - sizeof(payload_buf)));
		if (ret == 0) {
			return -EIO;
		} else if (ret < 0) {
			return ret;
		}

		length -= ret;
	}

	ret = mqtt_readall_publish_payload(c, payload_buf, length);
	if (ret) {
		return ret;
	}

	return err;
}

/**@brief Function to subscribe to the configured topic
 */
static int subscribe(struct mqtt_client *const c)
{
	struct mqtt_topic subscribe_topic = {
		.topic = {
			.utf8 = CONFIG_MQTT_SUB_TOPIC,
			.size = strlen(CONFIG_MQTT_SUB_TOPIC)
		},
		.qos = MQTT_QOS_1_AT_LEAST_ONCE
	};

	const struct mqtt_subscription_list subscription_list = {
		.list = &subscribe_topic,
		.list_count = 1,
		.message_id = 1234
	};

	LOG_INF("Subscribing to: %s len %u", CONFIG_MQTT_SUB_TOPIC,
		(unsigned int)strlen(CONFIG_MQTT_SUB_TOPIC));

	return mqtt_subscribe(c, &subscription_list);
}

/**@brief Function to print strings without null-termination
 */
static void data_print(uint8_t *prefix, uint8_t *data, size_t len)
{
	char buf[len + 1];

	memcpy(buf, data, len);
	buf[len] = 0;
	LOG_INF("%s%s", (char *)prefix, (char *)buf);
}

/**@brief Generic function to publish data on any topic
 */
int data_publish_generic(struct mqtt_client *c, char *topic, uint8_t *data, size_t len)
{
	struct mqtt_publish_param param;

	param.message.topic.qos = MQTT_QOS_1_AT_LEAST_ONCE;
	param.message.topic.topic.utf8 = topic;
	param.message.topic.topic.size = strlen(topic);
	param.message.payload.data = data;
	param.message.payload.len = len;
	param.message_id = sys_rand32_get();
	param.dup_flag = 0;
	param.retain_flag = 0;

	data_print("Publishing: ", data, len);
	LOG_INF("to topic: %s len: %u", topic, (unsigned int)strlen(topic));

	return mqtt_publish(c, &param);
}

/**@brief Function to publish data on the default topic
 */
int data_publish(struct mqtt_client *c, uint8_t *data, size_t len)
{
	return data_publish_generic(c, CONFIG_MQTT_PUB_TOPIC, data, len);
}

/**@brief MQTT client event handler
 */
void mqtt_evt_handler(struct mqtt_client *const c,
		      const struct mqtt_evt *evt)
{
	int err;

	switch (evt->type) {
	case MQTT_EVT_CONNACK:
		if (evt->result != 0) {
			LOG_ERR("MQTT connect failed: %d", evt->result);
			break;
		}

		LOG_INF("MQTT client connected");
		subscribe(c);
		break;

	case MQTT_EVT_DISCONNECT:
		LOG_INF("MQTT client disconnected: %d", evt->result);
		break;

	case MQTT_EVT_PUBLISH:
	{
		const struct mqtt_publish_param *p = &evt->param.publish;
		//Print the length of the recived message 
		LOG_INF("MQTT PUBLISH result=%d len=%d",
			evt->result, p->message.payload.len);

		//Extract the data of the recived message 
		err = get_received_payload(c, p->message.payload.len);
		
		//Send acknowledgment to the broker on receiving QoS1 publish message 
		if (p->message.topic.qos == MQTT_QOS_1_AT_LEAST_ONCE) {
			const struct mqtt_puback_param ack = {
				.message_id = p->message_id
			};

			/* Send acknowledgment. */
			mqtt_publish_qos1_ack(c, &ack);
		}

		if (err >= 0) {
			data_print("Received: ", payload_buf, p->message.payload.len);
			// Control LED1 and LED2 
			if(strncmp(payload_buf,CONFIG_TURN_LED1_ON_CMD,sizeof(CONFIG_TURN_LED1_ON_CMD)-1) == 0){
				dk_set_led_on(DK_LED1);
			}
			else if(strncmp(payload_buf,CONFIG_TURN_LED1_OFF_CMD,sizeof(CONFIG_TURN_LED1_OFF_CMD)-1) == 0){
				dk_set_led_off(DK_LED1);
			}
			else if(strncmp(payload_buf,CONFIG_TURN_LED2_ON_CMD,sizeof(CONFIG_TURN_LED2_ON_CMD)-1) == 0){
				dk_set_led_on(DK_LED2);
			}
			else if(strncmp(payload_buf,CONFIG_TURN_LED2_OFF_CMD,sizeof(CONFIG_TURN_LED2_OFF_CMD)-1) == 0){
				dk_set_led_off(DK_LED2);
			}

		// Payload buffer is smaller than the received data 
		} else if (err == -EMSGSIZE) {
			LOG_ERR("Received payload (%d bytes) is larger than the payload buffer size (%d bytes).",
				p->message.payload.len, sizeof(payload_buf));
		// Failed to extract data, disconnect 
		} else {
			LOG_ERR("get_received_payload failed: %d", err);
			LOG_INF("Disconnecting MQTT client...");

			err = mqtt_disconnect(c);
			if (err) {
				LOG_ERR("Could not disconnect: %d", err);
			}
		}
	} break;

	case MQTT_EVT_PUBACK:
		if (evt->result != 0) {
			LOG_ERR("MQTT PUBACK error: %d", evt->result);
			break;
		}

		LOG_INF("PUBACK packet id: %u", evt->param.puback.message_id);
		break;

	case MQTT_EVT_SUBACK:
		if (evt->result != 0) {
			LOG_ERR("MQTT SUBACK error: %d", evt->result);
			break;
		}

		LOG_INF("SUBACK packet id: %u", evt->param.suback.message_id);
		break;

	case MQTT_EVT_PINGRESP:
		if (evt->result != 0) {
			LOG_ERR("MQTT PINGRESP error: %d", evt->result);
		}
		break;

	default:
		LOG_INF("Unhandled MQTT event type: %d", evt->type);
		break;
	}
}

/**@brief Resolves the configured hostname and
 * initializes the MQTT broker structure
 */
static int broker_init(void)
{
	int err;
	struct addrinfo *result;
	struct addrinfo *addr;
	struct addrinfo hints = {
		.ai_family = AF_INET,
		.ai_socktype = SOCK_STREAM
	};

	err = getaddrinfo(CONFIG_MQTT_BROKER_HOSTNAME, NULL, &hints, &result);
	if (err) {
		LOG_ERR("getaddrinfo failed: %d", err);
		return -ECHILD;
	}

	addr = result;

	/* Look for address of the broker. */
	while (addr != NULL) {
		/* IPv4 Address. */
		if (addr->ai_addrlen == sizeof(struct sockaddr_in)) {
			struct sockaddr_in *broker4 =
				((struct sockaddr_in *)&broker);
			char ipv4_addr[NET_IPV4_ADDR_LEN];

			broker4->sin_addr.s_addr =
				((struct sockaddr_in *)addr->ai_addr)
				->sin_addr.s_addr;
			broker4->sin_family = AF_INET;
			broker4->sin_port = htons(CONFIG_MQTT_BROKER_PORT);

			inet_ntop(AF_INET, &broker4->sin_addr.s_addr,
				  ipv4_addr, sizeof(ipv4_addr));
			LOG_INF("IPv4 Address found %s", (char *)(ipv4_addr));

			break;
		} else {
			LOG_ERR("ai_addrlen = %u should be %u or %u",
				(unsigned int)addr->ai_addrlen,
				(unsigned int)sizeof(struct sockaddr_in),
				(unsigned int)sizeof(struct sockaddr_in6));
		}

		addr = addr->ai_next;
	}

	/* Free the address. */
	freeaddrinfo(result);

	return err;
}

/* Function to get the client id */
static const uint8_t* client_id_get(void)
{
	static uint8_t client_id[MAX(sizeof(CONFIG_MQTT_CLIENT_ID),
				     CLIENT_ID_LEN)];

	if (strlen(CONFIG_MQTT_CLIENT_ID) > 0) {
		snprintf(client_id, sizeof(client_id), "%s",
			 CONFIG_MQTT_CLIENT_ID);
		goto exit;
	}

	uint32_t id = sys_rand32_get();
	snprintf(client_id, sizeof(client_id), "%s-%010u", CONFIG_BOARD, id);

exit:
	LOG_DBG("client_id = %s", (char *)client_id);

	return client_id;
}

/**@brief Initialize the MQTT client structure
 */
int client_init(struct mqtt_client *client)
{
	int err;
	/* Initializes the client instance. */
	mqtt_client_init(client);

	/* Resolves the configured hostname and initializes the MQTT broker structure */
	err = broker_init();
	if (err) {
		LOG_ERR("Failed to initialize broker connection");
		return err;
	}

	/* MQTT client configuration */
	client->broker = &broker;
	client->evt_cb = mqtt_evt_handler;
	client->client_id.utf8 = client_id_get();
	client->client_id.size = strlen(client->client_id.utf8);
	client->password = NULL;
	client->user_name = NULL;
	client->protocol_version = MQTT_VERSION_3_1_1;

	/* MQTT buffers configuration */
	client->rx_buf = rx_buffer;
	client->rx_buf_size = sizeof(rx_buffer);
	client->tx_buf = tx_buffer;
	client->tx_buf_size = sizeof(tx_buffer);

	/* We are not using TLS */
	client->transport.type = MQTT_TRANSPORT_NON_SECURE;


	return err;
}

/**@brief Initialize the file descriptor structure used by poll.
 */
int fds_init(struct mqtt_client *c, struct pollfd *fds)
{
	if (c->transport.type == MQTT_TRANSPORT_NON_SECURE) {
		fds->fd = c->transport.tcp.sock;
	} else {
		return -ENOTSUP;
	}

	fds->events = POLLIN;

	return 0;
}
```

## src/mqtt_connection.h
```c
/*
 * Copyright (c) 2023 Nordic Semiconductor ASA
 *
 * SPDX-License-Identifier: LicenseRef-Nordic-5-Clause
 */
#ifndef _MQTTCONNECTION_H_
#define _MQTTCONNECTION_H_
#define RANDOM_LEN 10
#define CLIENT_ID_LEN sizeof(CONFIG_BOARD) + 1 + RANDOM_LEN
/**@brief Initialize the MQTT client structure
 */
int client_init(struct mqtt_client *client);

/**@brief Initialize the file descriptor structure used by poll.
 */
int fds_init(struct mqtt_client *c, struct pollfd *fds);

/**@brief Function to publish data on the configured topic
 */
int data_publish(struct mqtt_client *c, uint8_t *data, size_t len);

int data_temp_publish(struct mqtt_client *c, float temp);

#endif /* _CONNECTION_H_ */
```
